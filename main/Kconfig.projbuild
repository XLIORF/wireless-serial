## main/Kconfig.projbuild
```kconfig
menu "无线串口配置"

choice WIFI_MODE
    prompt "WiFi mode"
    default STATION_MODE
    help
        WiFi mode(station or softap).
    
config STATION_MODE
    bool "Station"
config SOFTAP_MODE
    bool "Softap"
endchoice
      
config ESPNOW_PMK
    string "ESPNOW primary master key"
    default "pmk1234567890123"
    help
        ESPNOW primary master for the example to use. The length of ESPNOW primary master must be 16 bytes.

config ESPNOW_LMK
    string "ESPNOW local master key"
    default "lmk1234567890123"
    help
        ESPNOW local master for the example to use. The length of ESPNOW local master must be 16 bytes.
        
config ESPNOW_CHANNEL
    int "Channel"
    default 1
    range 1 13
    help
        The channel on which sending and receiving ESPNOW data.

config ESPNOW_SEND_COUNT
    int "Send count"
    default 100
    range 1 65535
    help
        Total count of unicast ESPNOW data to be sent.
        
config ESPNOW_SEND_DELAY
    int "Send delay"
    default 1000
    range 0 65535
    help
        Delay between sending two ESPNOW data, unit: ms.
        
config ESPNOW_SEND_LEN
    int "Send len"
    range 10 250
    default 200
    help
        Length of ESPNOW data to be sent, unit: byte.

config CONNECT_INTERVAL
    int "连接包发送间隔(ms)"
    range 100 3000
    default 1000
    help    
        两个连接包之间的间隔，在较差的电磁环境中，此值不应该过小，避免连接包不匹配导致连接失败


config BROADCAST_INTERVAL
    int "广播包发送间隔(ms)"
    range 1000 3000
    default 1000


config HEARTBEAT_INTERVAL
    int "心跳包发送间隔(ms)"
    range 1000 10000
    default 3000
    help
        心跳包的发送间隔，心跳断开检查会比此值多一秒


config WLCON_MANAGER_PRORITY
    int "无线连接管理进程优先级"
    range 1 16
    default 6
    help
        管理无线发现，连接，心跳，数据发送的任务

config UART_BUF_SIZE
    int "串口缓冲区的大小"
    default 1024

config WLCON_IO_QUEUE_SIZE
    int "无线IO队列长度"
    default 128
    help
        串口与无线传输函数之间的队列长度

config CONNECT_RETRY
    int "连接重试次数"
    default 3
    help
        发起连接尝试的次数，超过此次数后再次广播
endmenu
```
